/* USER CODE BEGIN Dash_Font */
/* Generated by tools/gen_dash_fonts.sh, do not edit. */
/*******************************************************************************
 * Size: 180 px
 * Bpp: 4
 * Opts: --no-compress --bpp 4 --size 180 --format lvgl --font tools/fonts/BarlowSemiCondensed-Bold.ttf --symbols 0123456789- -o stm32_port/Core/Src/fonts/dash_font_speed.c --lv-font-name dash_font_speed
 ******************************************************************************/

#ifdef LV_LVGL_H_INCLUDE_SIMPLE
#include "lvgl.h"
#else
#include "../../lvgl/lvgl.h"
#endif

#ifndef DASH_FONT_SPEED
#define DASH_FONT_SPEED 1
#endif

#if DASH_FONT_SPEED

/*-----------------
 *    BITMAPS
 *----------------*/

/*Store the image of the glyphs*/
static LV_ATTRIBUTE_LARGE_CONST const uint8_t glyph_bitmap[] = {
    /* U+002D "-" */
    0x4, 0xbc, 0xcc, 0xcc, 0xcc, 0xcc, 0xcc, 0xcc,
    0xcc, 0xcc, 0xcc, 0xcc, 0xcc, 0xcc, 0xcc, 0xcc,
    0xcc, 0xcc, 0xcc, 0xcc, 0xcc, 0xcc, 0xcc, 0xcc,
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    0xff, 0xff, 0xff, 0xff, 0xff, 0xd2,

    /* U+0030 "0" */
    0x0, 0x0, 0x0, 0x0, 0x0, 0x0, 0x0, 0x0,
    0x0, 0x0, 0x0, 0x0, 0x0, 0x0, 0x0, 0x14,
    0x68, 0xac, 0xde, 0xef, 0xfe, 0xdd, 0xca, 0x86,
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    0x0, 0x0, 0x0, 0x0, 0x0, 0x0, 0x0, 0x0,

    /* U+0031 "1" */
    0x0, 0x0, 0x0, 0x0, 0x0, 0x0, 0x0, 0x0,
    0x0, 0x0, 0x0, 0x1, 0x11, 0x11, 0x11, 0x11,
    0x11, 0x11, 0x11, 0x11, 0x11, 0x10, 0x0, 0x0,
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    0x0,

    /* U+0032 "2" */
    0x0, 0x0, 0x0, 0x0, 0x0, 0x0, 0x0, 0x0,
    0x0, 0x0, 0x0, 0x0, 0x0, 0x0, 0x0, 0x2,
    0x46, 0x89, 0xab, 0xbc, 0xcb, 0xb9, 0x87, 0x42,
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    0xff, 0xff, 0xff, 0xff, 0xff, 0xff, 0xff, 0xa0,

    /* U+0033 "3" */
    0x0, 0x7, 0xcc, 0xcc, 0xcc, 0xcc, 0xcc, 0xcc,
    0xcc, 0xcc, 0xcc, 0xcc, 0xcc, 0xcc, 0xcc, 0xcc,
    0xcc, 0xcc, 0xcc, 0xcc, 0xcc, 0xcc, 0xcc, 0xcc,
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    0x0, 0x0, 0x0, 0x0, 0x0, 0x0, 0x0, 0x0,

    /* U+0034 "4" */
    0x0, 0x0, 0x0, 0x0, 0x0, 0x0, 0x0, 0x0,
    0x0, 0x0, 0x0, 0x0, 0x0, 0x0, 0x6, 0xef,
    0xff, 0xff, 0xff, 0xff, 0xff, 0xff, 0xff, 0xff,
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    0xff, 0xc1, 0x0, 0x0, 0x0, 0x0, 0x0,

    /* U+0035 "5" */
    0x5, 0xef, 0xff, 0xff, 0xff, 0xff, 0xff, 0xff,
    0xff, 0xff, 0xff, 0xff, 0xff, 0xff, 0xff, 0xff,
    0xff, 0xff, 0xff, 0xff, 0xff, 0xff, 0xff, 0xff,
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    0x0, 0x0,

    /* U+0036 "6" */
    0x0, 0x0, 0x0, 0x0, 0x0, 0x0, 0x0, 0x0,
    0x0, 0x0, 0x0, 0x0, 0x0, 0x0, 0x25, 0x79,
    0xbc, 0xee, 0xff, 0xff, 0xee, 0xcb, 0x97, 0x41,
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    0x0, 0x0, 0x0, 0x0, 0x0, 0x0, 0x0,

    /* U+0037 "7" */
    0x1, 0x9c, 0xcc, 0xcc, 0xcc, 0xcc, 0xcc, 0xcc,
    0xcc, 0xcc, 0xcc, 0xcc, 0xcc, 0xcc, 0xcc, 0xcc,
    0xcc, 0xcc, 0xcc, 0xcc, 0xcc, 0xcc, 0xcc, 0xcc,
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    0x0,

    /* U+0038 "8" */
    0x0, 0x0, 0x0, 0x0, 0x0, 0x0, 0x0, 0x0,
    0x0, 0x0, 0x0, 0x0, 0x0, 0x0, 0x0, 0x25,
    0x79, 0xab, 0xcc, 0xcc, 0xba, 0x98, 0x63, 0x10,
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    0x0, 0x0, 0x0, 0x0, 0x0,

    /* U+0039 "9" */
    0x0, 0x0, 0x0, 0x0, 0x0, 0x0, 0x0, 0x0,
    0x0, 0x0, 0x0, 0x0, 0x0, 0x0, 0x0, 0x14,
    0x68, 0x9a, 0xbc, 0xcc, 0xcb, 0xa9, 0x75, 0x30,
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    0x0, 0x0, 0x0, 0x0, 0x0, 0x0, 0x0
};


/*---------------------
 *  GLYPH DESCRIPTION
 *--------------------*/

static const lv_font_fmt_txt_glyph_dsc_t glyph_dsc[] = {
    {.bitmap_index = 0, .adv_w = 0, .box_w = 0, .box_h = 0, .ofs_x = 0, .ofs_y = 0} /* id = 0 reserved */,
    {.bitmap_index = 0, .adv_w = 1066, .box_w = 58, .box_h = 22, .ofs_x = 4, .ofs_y = 42},
    {.bitmap_index = 638, .adv_w = 1472, .box_w = 80, .box_h = 130, .ofs_x = 6, .ofs_y = -2},
    {.bitmap_index = 5838, .adv_w = 919, .box_w = 47, .box_h = 127, .ofs_x = 3, .ofs_y = 0},
    {.bitmap_index = 8823, .adv_w = 1437, .box_w = 80, .box_h = 128, .ofs_x = 5, .ofs_y = 0},
    {.bitmap_index = 13943, .adv_w = 1403, .box_w = 76, .box_h = 128, .ofs_x = 5, .ofs_y = -1},
    {.bitmap_index = 18807, .adv_w = 1567, .box_w = 89, .box_h = 126, .ofs_x = 4, .ofs_y = 0},
    {.bitmap_index = 24414, .adv_w = 1405, .box_w = 77, .box_h = 127, .ofs_x = 6, .ofs_y = -1},
    {.bitmap_index = 29304, .adv_w = 1405, .box_w = 77, .box_h = 129, .ofs_x = 6, .ofs_y = -1},
    {.bitmap_index = 34271, .adv_w = 1299, .box_w = 78, .box_h = 127, .ofs_x = 2, .ofs_y = -1},
    {.bitmap_index = 39224, .adv_w = 1411, .box_w = 77, .box_h = 130, .ofs_x = 6, .ofs_y = -1},
    {.bitmap_index = 44229, .adv_w = 1388, .box_w = 78, .box_h = 129, .ofs_x = 3, .ofs_y = -1}
};

/*---------------------
 *  CHARACTER MAPPING
 *--------------------*/

static const uint8_t glyph_id_ofs_list_0[] = {
    0, 0, 0, 1, 2, 3, 4, 5,
    6, 7, 8, 9, 10
};

/*Collect the unicode lists and glyph_id offsets*/
static const lv_font_fmt_txt_cmap_t cmaps[] =
{
    {
        .range_start = 45, .range_length = 13, .glyph_id_start = 1,
        .unicode_list = NULL, .glyph_id_ofs_list = glyph_id_ofs_list_0, .list_length = 13, .type = LV_FONT_FMT_TXT_CMAP_FORMAT0_FULL
    }
};

/*-----------------
 *    KERNING
 *----------------*/


/*Pair left and right glyphs for kerning*/
static const uint8_t kern_pair_glyph_ids[] =
{
    1, 9,
    2, 3,
    3, 3,
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    11, 3
};

/* Kerning between the respective left and right glyphs
 * 4.4 format which needs to scaled with `kern_scale`*/
static const int8_t kern_pair_values[] =
{
    -62, -10, -2, 3, -16, -11, -14, -119,
    -102, -16, -14, 3, -21, -27
};

/*Collect the kern pair's data in one place*/
static const lv_font_fmt_txt_kern_pair_t kern_pairs =
{
    .glyph_ids = kern_pair_glyph_ids,
    .values = kern_pair_values,
    .pair_cnt = 14,
    .glyph_ids_size = 0
};

/*--------------------
 *  ALL CUSTOM DATA
 *--------------------*/

#if LVGL_VERSION_MAJOR == 8
/*Store all the custom data of the font*/
static  lv_font_fmt_txt_glyph_cache_t cache;
#endif

#if LVGL_VERSION_MAJOR >= 8
static const lv_font_fmt_txt_dsc_t font_dsc = {
#else
static lv_font_fmt_txt_dsc_t font_dsc = {
#endif
    .glyph_bitmap = glyph_bitmap,
    .glyph_dsc = glyph_dsc,
    .cmaps = cmaps,
    .kern_dsc = &kern_pairs,
    .kern_scale = 29,
    .cmap_num = 1,
    .bpp = 4,
    .kern_classes = 0,
    .bitmap_format = 0,
#if LVGL_VERSION_MAJOR == 8
    .cache = &cache
#endif
};



/*-----------------
 *  PUBLIC FONT
 *----------------*/

/*Initialize a public general font descriptor*/
#if LVGL_VERSION_MAJOR >= 8
const lv_font_t dash_font_speed = {
#else
lv_font_t dash_font_speed = {
#endif
    .get_glyph_dsc = lv_font_get_glyph_dsc_fmt_txt,    /*Function pointer to get glyph's data*/
    .get_glyph_bitmap = lv_font_get_bitmap_fmt_txt,    /*Function pointer to get glyph's bitmap*/
    .line_height = 131,          /*The maximum line height required by the font*/
    .base_line = 2,             /*Baseline measured from the bottom of the line*/
#if !(LVGL_VERSION_MAJOR == 6 && LVGL_VERSION_MINOR == 0)
    .subpx = LV_FONT_SUBPX_NONE,
#endif
#if LV_VERSION_CHECK(7, 4, 0) || LVGL_VERSION_MAJOR >= 8
    .underline_position = -13,
    .underline_thickness = 9,
#endif
    .dsc = &font_dsc,          /*The custom font data. Will be accessed by `get_glyph_bitmap/dsc` */
#if LV_VERSION_CHECK(8, 2, 0) || LVGL_VERSION_MAJOR >= 9
    .fallback = NULL,
#endif
    .user_data = NULL,
};



#endif /*#if DASH_FONT_SPEED*/

/* USER CODE END Dash_Font */
