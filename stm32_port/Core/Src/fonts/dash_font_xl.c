/* USER CODE BEGIN Dash_Font */
/* Generated by tools/gen_dash_fonts.sh, do not edit. */
/*******************************************************************************
 * Size: 56 px
 * Bpp: 4
 * Opts: --no-compress --bpp 4 --size 56 --format lvgl --font tools/fonts/BarlowSemiCondensed-SemiBold.ttf --symbols 0123456789%-SQCE -o stm32_port/Core/Src/fonts/dash_font_xl.c --lv-font-name dash_font_xl
 ******************************************************************************/

#ifdef LV_LVGL_H_INCLUDE_SIMPLE
#include "lvgl.h"
#else
#include "../../lvgl/lvgl.h"
#endif

#ifndef DASH_FONT_XL
#define DASH_FONT_XL 1
#endif

#if DASH_FONT_XL

/*-----------------
 *    BITMAPS
 *----------------*/

/*Store the image of the glyphs*/
static LV_ATTRIBUTE_LARGE_CONST const uint8_t glyph_bitmap[] = {
    /* U+0025 "%" */
    0x0, 0x0, 0x4, 0x9d, 0xff, 0xda, 0x40, 0x0,
    0x0, 0x0, 0x0, 0x0, 0x0, 0x8, 0xff, 0xff,
    0x10, 0x0, 0x0, 0x0, 0x0, 0x1b, 0xff, 0xff,
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    0x0,

    /* U+002D "-" */
    0x18, 0x99, 0x99, 0x99, 0x99, 0x99, 0x99, 0x99,
    0x94, 0x4f, 0xff, 0xff, 0xff, 0xff, 0xff, 0xff,
    0xff, 0xfc, 0x5f, 0xff, 0xff, 0xff, 0xff, 0xff,
    0xff, 0xff, 0xfc, 0x5f, 0xff, 0xff, 0xff, 0xff,
    0xff, 0xff, 0xff, 0xfc, 0x5f, 0xff, 0xff, 0xff,
    0xff, 0xff, 0xff, 0xff, 0xfc, 0x3f, 0xff, 0xff,
    0xff, 0xff, 0xff, 0xff, 0xff, 0xfa,

    /* U+0030 "0" */
    0x0, 0x0, 0x0, 0x3, 0x7b, 0xdf, 0xfe, 0xd9,
    0x50, 0x0, 0x0, 0x0, 0x0, 0x0, 0x4, 0xcf,
    0xff, 0xff, 0xff, 0xff, 0xff, 0x80, 0x0, 0x0,
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    0x50, 0x0, 0x0, 0x0,

    /* U+0031 "1" */
    0x0, 0x0, 0x5, 0xdf, 0xff, 0xff, 0xf4, 0x0,
    0x6, 0xef, 0xff, 0xff, 0xff, 0xf6, 0x7, 0xef,
    0xff, 0xff, 0xff, 0xff, 0xf6, 0x7f, 0xff, 0xff,
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    0xf4,

    /* U+0032 "2" */
    0x0, 0x0, 0x0, 0x16, 0xad, 0xef, 0xfd, 0xa6,
    0x10, 0x0, 0x0, 0x0, 0x0, 0x0, 0x1a, 0xff,
    0xff, 0xff, 0xff, 0xff, 0xf8, 0x0, 0x0, 0x0,
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    0xff, 0xff, 0xff, 0xf4,

    /* U+0033 "3" */
    0x6, 0xff, 0xff, 0xff, 0xff, 0xff, 0xff, 0xff,
    0xff, 0xff, 0xff, 0xe0, 0x8, 0xff, 0xff, 0xff,
    0xff, 0xff, 0xff, 0xff, 0xff, 0xff, 0xff, 0xf1,
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    0x40, 0x0, 0x0, 0x0,

    /* U+0034 "4" */
    0x0, 0x0, 0x0, 0x0, 0x2, 0xff, 0xff, 0xff,
    0xa0, 0x0, 0x0, 0x0, 0x0, 0x0, 0x0, 0x0,
    0x0, 0x0, 0x8f, 0xff, 0xff, 0xf6, 0x0, 0x0,
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    0x0, 0x1f, 0xff, 0xff, 0xf3, 0x0, 0x0,

    /* U+0035 "5" */
    0x5f, 0xff, 0xff, 0xff, 0xff, 0xff, 0xff, 0xff,
    0xff, 0xff, 0xfc, 0x7, 0xff, 0xff, 0xff, 0xff,
    0xff, 0xff, 0xff, 0xff, 0xff, 0xff, 0xe0, 0x7f,
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    0x0,

    /* U+0036 "6" */
    0x0, 0x0, 0x0, 0x16, 0xad, 0xef, 0xed, 0xa6,
    0x10, 0x0, 0x0, 0x0, 0x0, 0x1, 0xaf, 0xff,
    0xff, 0xff, 0xff, 0xff, 0x90, 0x0, 0x0, 0x0,
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    0x0,

    /* U+0037 "7" */
    0xaf, 0xff, 0xff, 0xff, 0xff, 0xff, 0xff, 0xff,
    0xff, 0xff, 0xff, 0xac, 0xff, 0xff, 0xff, 0xff,
    0xff, 0xff, 0xff, 0xff, 0xff, 0xff, 0xfc, 0xcf,
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    0x0,

    /* U+0038 "8" */
    0x0, 0x0, 0x0, 0x16, 0xad, 0xff, 0xfd, 0xb7,
    0x10, 0x0, 0x0, 0x0, 0x0, 0x1, 0x9f, 0xff,
    0xff, 0xff, 0xff, 0xff, 0x91, 0x0, 0x0, 0x0,
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    0x0,

    /* U+0039 "9" */
    0x0, 0x0, 0x0, 0x3, 0x8c, 0xef, 0xfe, 0xc9,
    0x40, 0x0, 0x0, 0x0, 0x0, 0x0, 0x4, 0xdf,
    0xff, 0xff, 0xff, 0xff, 0xfd, 0x40, 0x0, 0x0,
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    0x61, 0x0, 0x0, 0x0,

    /* U+0043 "C" */
    0x0, 0x0, 0x0, 0x0, 0x59, 0xce, 0xff, 0xec,
    0xa5, 0x0, 0x0, 0x0, 0x0, 0x0, 0x0, 0x0,
    0x7e, 0xff, 0xff, 0xff, 0xff, 0xff, 0xf9, 0x10,
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    0x0, 0x0, 0x0,

    /* U+0045 "E" */
    0x4f, 0xff, 0xff, 0xff, 0xff, 0xff, 0xff, 0xff,
    0xff, 0xff, 0xff, 0xf7, 0x6f, 0xff, 0xff, 0xff,
    0xff, 0xff, 0xff, 0xff, 0xff, 0xff, 0xff, 0xf9,
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    0xff, 0xff, 0xff, 0xf7,

    /* U+0051 "Q" */
    0x0, 0x0, 0x0, 0x1, 0x6a, 0xdf, 0xff, 0xdb,
    0x61, 0x0, 0x0, 0x0, 0x0, 0x0, 0x0, 0x19,
    0xff, 0xff, 0xff, 0xff, 0xff, 0xfa, 0x10, 0x0,
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    0x0, 0x0, 0x0,

    /* U+0053 "S" */
    0x0, 0x0, 0x0, 0x5, 0x9c, 0xef, 0xfe, 0xca,
    0x61, 0x0, 0x0, 0x0, 0x0, 0x0, 0x0, 0x8e,
    0xff, 0xff, 0xff, 0xff, 0xff, 0xfa, 0x10, 0x0,
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    0xef, 0xfe, 0xdb, 0x84, 0x0, 0x0, 0x0, 0x0
};


/*---------------------
 *  GLYPH DESCRIPTION
 *--------------------*/

static const lv_font_fmt_txt_glyph_dsc_t glyph_dsc[] = {
    {.bitmap_index = 0, .adv_w = 0, .box_w = 0, .box_h = 0, .ofs_x = 0, .ofs_y = 0} /* id = 0 reserved */,
    {.bitmap_index = 0, .adv_w = 719, .box_w = 39, .box_h = 39, .ofs_x = 3, .ofs_y = 0},
    {.bitmap_index = 761, .adv_w = 326, .box_w = 18, .box_h = 6, .ofs_x = 1, .ofs_y = 14},
    {.bitmap_index = 815, .adv_w = 456, .box_w = 24, .box_h = 39, .ofs_x = 2, .ofs_y = 0},
    {.bitmap_index = 1283, .adv_w = 280, .box_w = 14, .box_h = 39, .ofs_x = 1, .ofs_y = 0},
    {.bitmap_index = 1556, .adv_w = 437, .box_w = 24, .box_h = 39, .ofs_x = 2, .ofs_y = 0},
    {.bitmap_index = 2024, .adv_w = 428, .box_w = 24, .box_h = 39, .ofs_x = 1, .ofs_y = 0},
    {.bitmap_index = 2492, .adv_w = 468, .box_w = 27, .box_h = 39, .ofs_x = 1, .ofs_y = 0},
    {.bitmap_index = 3019, .adv_w = 428, .box_w = 23, .box_h = 39, .ofs_x = 2, .ofs_y = 0},
    {.bitmap_index = 3468, .adv_w = 429, .box_w = 23, .box_h = 39, .ofs_x = 2, .ofs_y = 0},
    {.bitmap_index = 3917, .adv_w = 394, .box_w = 23, .box_h = 39, .ofs_x = 1, .ofs_y = 0},
    {.bitmap_index = 4366, .adv_w = 434, .box_w = 23, .box_h = 39, .ofs_x = 2, .ofs_y = 0},
    {.bitmap_index = 4815, .adv_w = 430, .box_w = 24, .box_h = 39, .ofs_x = 1, .ofs_y = 0},
    {.bitmap_index = 5283, .adv_w = 478, .box_w = 26, .box_h = 39, .ofs_x = 2, .ofs_y = 0},
    {.bitmap_index = 5790, .adv_w = 460, .box_w = 24, .box_h = 39, .ofs_x = 3, .ofs_y = 0},
    {.bitmap_index = 6258, .adv_w = 467, .box_w = 25, .box_h = 45, .ofs_x = 2, .ofs_y = -6},
    {.bitmap_index = 6821, .adv_w = 460, .box_w = 25, .box_h = 39, .ofs_x = 2, .ofs_y = 0}
};

/*---------------------
 *  CHARACTER MAPPING
 *--------------------*/

static const uint16_t unicode_list_0[] = {
    0x0, 0x8, 0xb, 0xc, 0xd, 0xe, 0xf, 0x10,
    0x11, 0x12, 0x13, 0x14, 0x1e, 0x20, 0x2c, 0x2e
};

/*Collect the unicode lists and glyph_id offsets*/
static const lv_font_fmt_txt_cmap_t cmaps[] =
{
    {
        .range_start = 37, .range_length = 47, .glyph_id_start = 1,
        .unicode_list = unicode_list_0, .glyph_id_ofs_list = NULL, .list_length = 16, .type = LV_FONT_FMT_TXT_CMAP_SPARSE_TINY
    }
};

/*-----------------
 *    KERNING
 *----------------*/


/*Pair left and right glyphs for kerning*/
static const uint8_t kern_pair_glyph_ids[] =
{
    2, 10,
    3, 4,
    4, 4,
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    16, 14
};

/* Kerning between the respective left and right glyphs
 * 4.4 format which needs to scaled with `kern_scale`*/
static const int8_t kern_pair_values[] =
{
    -28, -8, -4, 1, -13, -5, -13, -65,
    -49, -13, -13, 1, -18, -19, -4, -2,
    -4, -2
};

/*Collect the kern pair's data in one place*/
static const lv_font_fmt_txt_kern_pair_t kern_pairs =
{
    .glyph_ids = kern_pair_glyph_ids,
    .values = kern_pair_values,
    .pair_cnt = 18,
    .glyph_ids_size = 0
};

/*--------------------
 *  ALL CUSTOM DATA
 *--------------------*/

#if LVGL_VERSION_MAJOR == 8
/*Store all the custom data of the font*/
static  lv_font_fmt_txt_glyph_cache_t cache;
#endif

#if LVGL_VERSION_MAJOR >= 8
static const lv_font_fmt_txt_dsc_t font_dsc = {
#else
static lv_font_fmt_txt_dsc_t font_dsc = {
#endif
    .glyph_bitmap = glyph_bitmap,
    .glyph_dsc = glyph_dsc,
    .cmaps = cmaps,
    .kern_dsc = &kern_pairs,
    .kern_scale = 16,
    .cmap_num = 1,
    .bpp = 4,
    .kern_classes = 0,
    .bitmap_format = 0,
#if LVGL_VERSION_MAJOR == 8
    .cache = &cache
#endif
};



/*-----------------
 *  PUBLIC FONT
 *----------------*/

/*Initialize a public general font descriptor*/
#if LVGL_VERSION_MAJOR >= 8
const lv_font_t dash_font_xl = {
#else
lv_font_t dash_font_xl = {
#endif
    .get_glyph_dsc = lv_font_get_glyph_dsc_fmt_txt,    /*Function pointer to get glyph's data*/
    .get_glyph_bitmap = lv_font_get_bitmap_fmt_txt,    /*Function pointer to get glyph's bitmap*/
    .line_height = 45,          /*The maximum line height required by the font*/
    .base_line = 6,             /*Baseline measured from the bottom of the line*/
#if !(LVGL_VERSION_MAJOR == 6 && LVGL_VERSION_MINOR == 0)
    .subpx = LV_FONT_SUBPX_NONE,
#endif
#if LV_VERSION_CHECK(7, 4, 0) || LVGL_VERSION_MAJOR >= 8
    .underline_position = -4,
    .underline_thickness = 3,
#endif
    .dsc = &font_dsc,          /*The custom font data. Will be accessed by `get_glyph_bitmap/dsc` */
#if LV_VERSION_CHECK(8, 2, 0) || LVGL_VERSION_MAJOR >= 9
    .fallback = NULL,
#endif
    .user_data = NULL,
};



#endif /*#if DASH_FONT_XL*/

/* USER CODE END Dash_Font */
